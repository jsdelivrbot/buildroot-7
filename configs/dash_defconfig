## package/agco/diagd/Config.in
```kconfig
config BR2_PACKAGE_DIAGD
	bool "diagd"
	depends on !BR2_STATIC_LIBS
	depends on BR2_USE_MMU
	help
	  The Diagnostic Daemon provides an extensible node
	  implementation of UDS services according to ISO14229
          over DoIP (ISO13400) and DoCAN (ISO15765) network layers
          for Linux ECUs.

	  https://git.mod.agcocorp.com/git/Diagnostics/diagd

if BR2_PACKAGE_DIAGD

config BR2_PACKAGE_DIAGD_DEVELMODE
	bool "Development mode"
	help
	  - Seed 0x12121212 / key 0x02020202 unlock any security level
	  - Never delay security access requests

choice
	bool "Target platform"
	default BR2_PACKAGE_DIAGD_TARGET_IU
	help
	  Choose the target platform for to support.

config BR2_PACKAGE_DIAGD_TARGET_DASH
	bool "Dashboard"
	help
	  Dashboard for 2019 new electronic architecture.

config BR2_PACKAGE_DIAGD_TARGET_DCU
	bool "Display Control Unit"
	help
	  DCU / Terminal.

config BR2_PACKAGE_DIAGD_TARGET_IU
	bool "Infotainment Unit"
	help
	  Infotainment Unit.

endchoice # Target platform

config BR2_PACKAGE_DIAGD_DEM
	bool "Diagnostic events"
	default y
	help
	  Enable support for Diagnostic Trouble Codes (DTC)
	  in diagd by including the Diagnostic Event Manager.

config BR2_PACKAGE_DIAGD_DIAGBUS
	bool "Diagnostic bus"
	help
	  IPC mechanism for delegating diagnostic requests
	  to other programs.

endif
```

## package/lpppd/Config.in
```kconfig
config BR2_PACKAGE_LPPPD
	bool "lpppd"
	depends on !BR2_STATIC_LIBS
	depends on !BR2_PACKAGE_PPPD
	depends on BR2_USE_MMU
	help
	  A fork of the Point-to-point protocol daemon
	  for Linux systems.

	  https://github.com/snickl/lpppd

if BR2_PACKAGE_LPPPD

config BR2_PACKAGE_LPPPD_FILTER
	select BR2_PACKAGE_LIBPCAP
	bool "filtering"
	help
	  Packet filtering abilities for lpppd. If enabled,
	  the lpppd active-filter and pass-filter options
	  are available.

config BR2_PACKAGE_LPPPD_MULTILINK
	bool "multilink"
	help
	  Enable multilink

endif

comment "lpppd conflicts with pppd"
        depends on BR2_PACKAGE_PPPD

comment "lpppd needs a toolchain w/ dynamic library"
	depends on BR2_STATIC_LIBS
	depends on BR2_USE_MMU
```

## package/pppd/Config.in
```kconfig
config BR2_PACKAGE_PPPD
	bool "pppd"
	depends on !BR2_STATIC_LIBS
	depends on BR2_USE_MMU
	help
	  An implementation of the Point-to-point protocol.

	  http://www.samba.org/ppp/

if BR2_PACKAGE_PPPD

config BR2_PACKAGE_PPPD_FILTER
	bool "filtering"
	select BR2_PACKAGE_LIBPCAP
	help
	  Packet filtering abilities for pppd. If enabled,
	  the pppd active-filter and pass-filter options
	  are available.

config BR2_PACKAGE_PPPD_MSCHAPMPPE
	bool "mschap+mppe"
	help
	  Enable MS-CHAP and MPPE

config BR2_PACKAGE_PPPD_MULTILINKTDB
	bool "multilink+tdb"
	help
	  Enable multilink and TDB

config BR2_PACKAGE_PPPD_PLUGINS
	bool "plugins"
	help
	  Enable plugins

config BR2_PACKAGE_PPPD_RADIUS
	bool "radius"
	depends on BR2_PACKAGE_PPPD_PLUGINS
	help
	  Install RADIUS support for pppd

endif

comment "pppd needs a toolchain w/ dynamic library"
	depends on BR2_STATIC_LIBS
	depends on BR2_USE_MMU
```
